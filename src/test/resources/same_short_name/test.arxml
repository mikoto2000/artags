AUTOSAR XML (schema 4-0-3)
standard types defined: sint8
package /ImplDataTypes
  impl type ImplDataType1: category=VALUE, base-type=Parent/sint8
  impl type ImplDataType2: category=VALUE, base-type=Child/sint8
