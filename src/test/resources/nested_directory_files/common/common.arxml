AUTOSAR XML (schema 4-0-3)
standard types defined: sint8
package /ImplDataTypes
  impl type ImplDataType: category=VALUE, base-type=sint8
